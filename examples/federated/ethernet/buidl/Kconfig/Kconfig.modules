## examples/federated/ethernet/buidl/Kconfig/Kconfig.modules
```kconfig
menu "acpica (/home/tanneberger/workspace/lf/lf-west-template/deps/modules/lib/acpica)"
osource "$(ZEPHYR_ACPICA_KCONFIG)"
config ZEPHYR_ACPICA_MODULE
	bool
	default y
endmenu
menu "cmsis (/home/tanneberger/workspace/lf/lf-west-template/deps/modules/hal/cmsis)"
osource "$(ZEPHYR_CMSIS_KCONFIG)"
config ZEPHYR_CMSIS_MODULE
	bool
	default y
endmenu
menu "cmsis-dsp (/home/tanneberger/workspace/lf/lf-west-template/deps/modules/lib/cmsis-dsp)"
osource "$(ZEPHYR_CMSIS_DSP_KCONFIG)"
config ZEPHYR_CMSIS_DSP_MODULE
	bool
	default y
endmenu
menu "cmsis-nn (/home/tanneberger/workspace/lf/lf-west-template/deps/modules/lib/cmsis-nn)"
osource "$(ZEPHYR_CMSIS_NN_KCONFIG)"
config ZEPHYR_CMSIS_NN_MODULE
	bool
	default y
endmenu
menu "fatfs (/home/tanneberger/workspace/lf/lf-west-template/deps/modules/fs/fatfs)"
osource "$(ZEPHYR_FATFS_KCONFIG)"
config ZEPHYR_FATFS_MODULE
	bool
	default y
endmenu
config ZEPHYR_ADI_MODULE
   bool
   default y
config ZEPHYR_ALTERA_MODULE
   bool
   default y
menu "hal_ambiq (/home/tanneberger/workspace/lf/lf-west-template/deps/modules/hal/ambiq)"
osource "$(ZEPHYR_HAL_AMBIQ_KCONFIG)"
config ZEPHYR_HAL_AMBIQ_MODULE
	bool
	default y
endmenu
config ZEPHYR_ATMEL_MODULE
   bool
   default y
menu "hal_espressif (/home/tanneberger/workspace/lf/lf-west-template/deps/modules/hal/espressif)"
osource "/home/tanneberger/workspace/lf/lf-west-template/deps/modules/hal/espressif/zephyr/Kconfig"
config ZEPHYR_HAL_ESPRESSIF_MODULE
	bool
	default y
endmenu
menu "hal_ethos_u (/home/tanneberger/workspace/lf/lf-west-template/deps/modules/hal/ethos_u)"
osource "$(ZEPHYR_HAL_ETHOS_U_KCONFIG)"
config ZEPHYR_HAL_ETHOS_U_MODULE
	bool
	default y
endmenu
menu "hal_gigadevice (/home/tanneberger/workspace/lf/lf-west-template/deps/modules/hal/gigadevice)"
osource "$(ZEPHYR_HAL_GIGADEVICE_KCONFIG)"
config ZEPHYR_HAL_GIGADEVICE_MODULE
	bool
	default y
endmenu
menu "hal_infineon (/home/tanneberger/workspace/lf/lf-west-template/deps/modules/hal/infineon)"
osource "$(ZEPHYR_HAL_INFINEON_KCONFIG)"
config ZEPHYR_HAL_INFINEON_MODULE
	bool
	default y
endmenu
menu "hal_intel (/home/tanneberger/workspace/lf/lf-west-template/deps/modules/hal/intel)"
osource "/home/tanneberger/workspace/lf/lf-west-template/deps/modules/hal/intel/zephyr/Kconfig"
config ZEPHYR_HAL_INTEL_MODULE
	bool
	default y
endmenu
config ZEPHYR_MICROCHIP_MODULE
   bool
   default y
menu "hal_nordic (/home/tanneberger/workspace/lf/lf-west-template/deps/modules/hal/nordic)"
osource "$(ZEPHYR_HAL_NORDIC_KCONFIG)"
config ZEPHYR_HAL_NORDIC_MODULE
	bool
	default y
endmenu
config ZEPHYR_NUVOTON_MODULE
   bool
   default y
menu "hal_nxp (/home/tanneberger/workspace/lf/lf-west-template/deps/modules/hal/nxp)"
osource "$(ZEPHYR_HAL_NXP_KCONFIG)"
config ZEPHYR_HAL_NXP_MODULE
	bool
	default y
endmenu
config ZEPHYR_OPENISA_MODULE
   bool
   default y
config ZEPHYR_QUICKLOGIC_MODULE
   bool
   default y
config ZEPHYR_HAL_RENESAS_MODULE
   bool
   default y
menu "hal_rpi_pico (/home/tanneberger/workspace/lf/lf-west-template/deps/modules/hal/rpi_pico)"
osource "$(ZEPHYR_HAL_RPI_PICO_KCONFIG)"
config ZEPHYR_HAL_RPI_PICO_MODULE
	bool
	default y
endmenu
menu "hal_silabs (/home/tanneberger/workspace/lf/lf-west-template/deps/modules/hal/silabs)"
osource "/home/tanneberger/workspace/lf/lf-west-template/deps/modules/hal/silabs/zephyr/Kconfig"
config ZEPHYR_HAL_SILABS_MODULE
	bool
	default y
endmenu
menu "hal_st (/home/tanneberger/workspace/lf/lf-west-template/deps/modules/hal/st)"
osource "$(ZEPHYR_HAL_ST_KCONFIG)"
config ZEPHYR_HAL_ST_MODULE
	bool
	default y
endmenu
config ZEPHYR_STM32_MODULE
   bool
   default y
menu "hal_telink (/home/tanneberger/workspace/lf/lf-west-template/deps/modules/hal/telink)"
osource "/home/tanneberger/workspace/lf/lf-west-template/deps/modules/hal/telink/Kconfig"
config ZEPHYR_HAL_TELINK_MODULE
	bool
	default y
endmenu
config ZEPHYR_TI_MODULE
   bool
   default y
config ZEPHYR_HAL_WURTHELEKTRONIK_MODULE
   bool
   default y
config ZEPHYR_XTENSA_MODULE
   bool
   default y
menu "hostap (/home/tanneberger/workspace/lf/lf-west-template/deps/modules/lib/hostap)"
osource "$(ZEPHYR_HOSTAP_KCONFIG)"
config ZEPHYR_HOSTAP_MODULE
	bool
	default y
endmenu
config ZEPHYR_LIBMETAL_MODULE
   bool
   default y
menu "liblc3 (/home/tanneberger/workspace/lf/lf-west-template/deps/modules/lib/liblc3)"
osource "$(ZEPHYR_LIBLC3_KCONFIG)"
config ZEPHYR_LIBLC3_MODULE
	bool
	default y
endmenu
menu "littlefs (/home/tanneberger/workspace/lf/lf-west-template/deps/modules/fs/littlefs)"
osource "$(ZEPHYR_LITTLEFS_KCONFIG)"
config ZEPHYR_LITTLEFS_MODULE
	bool
	default y
endmenu
menu "loramac-node (/home/tanneberger/workspace/lf/lf-west-template/deps/modules/lib/loramac-node)"
osource "$(ZEPHYR_LORAMAC_NODE_KCONFIG)"
config ZEPHYR_LORAMAC_NODE_MODULE
	bool
	default y
endmenu
menu "lvgl (/home/tanneberger/workspace/lf/lf-west-template/deps/modules/lib/gui/lvgl)"
osource "/home/tanneberger/workspace/lf/lf-west-template/deps/modules/lib/gui/lvgl/Kconfig"
config ZEPHYR_LVGL_MODULE
	bool
	default y
endmenu
menu "mbedtls (/home/tanneberger/workspace/lf/lf-west-template/deps/modules/crypto/mbedtls)"
osource "$(ZEPHYR_MBEDTLS_KCONFIG)"
config ZEPHYR_MBEDTLS_MODULE
	bool
	default y
endmenu
config ZEPHYR_MCUBOOT_MODULE
   bool
   default y
config ZEPHYR_MIPI_SYS_T_MODULE
   bool
   default y
config ZEPHYR_NRF_HW_MODELS_MODULE
   bool
   default y
config ZEPHYR_OPEN_AMP_MODULE
   bool
   default y
menu "openthread (/home/tanneberger/workspace/lf/lf-west-template/deps/modules/lib/openthread)"
osource "$(ZEPHYR_OPENTHREAD_KCONFIG)"
config ZEPHYR_OPENTHREAD_MODULE
	bool
	default y
endmenu
menu "percepio (/home/tanneberger/workspace/lf/lf-west-template/deps/modules/debug/percepio)"
osource "/home/tanneberger/workspace/lf/lf-west-template/deps/modules/debug/percepio/zephyr/Kconfig"
config ZEPHYR_PERCEPIO_MODULE
	bool
	default y
endmenu
menu "picolibc (/home/tanneberger/workspace/lf/lf-west-template/deps/modules/lib/picolibc)"
osource "/home/tanneberger/workspace/lf/lf-west-template/deps/modules/lib/picolibc/zephyr/Kconfig"
config ZEPHYR_PICOLIBC_MODULE
	bool
	default y
endmenu
menu "segger (/home/tanneberger/workspace/lf/lf-west-template/deps/modules/debug/segger)"
osource "$(ZEPHYR_SEGGER_KCONFIG)"
config ZEPHYR_SEGGER_MODULE
	bool
	default y
endmenu
config ZEPHYR_TINYCRYPT_MODULE
   bool
   default y
menu "trusted-firmware-m (/home/tanneberger/workspace/lf/lf-west-template/deps/modules/tee/tf-m/trusted-firmware-m)"
osource "$(ZEPHYR_TRUSTED_FIRMWARE_M_KCONFIG)"
config ZEPHYR_TRUSTED_FIRMWARE_M_MODULE
	bool
	default y
endmenu
menu "trusted-firmware-a (/home/tanneberger/workspace/lf/lf-west-template/deps/modules/tee/tf-a/trusted-firmware-a)"
osource "$(ZEPHYR_TRUSTED_FIRMWARE_A_KCONFIG)"
config ZEPHYR_TRUSTED_FIRMWARE_A_MODULE
	bool
	default y
endmenu
menu "uoscore-uedhoc (/home/tanneberger/workspace/lf/lf-west-template/deps/modules/lib/uoscore-uedhoc)"
osource "$(ZEPHYR_UOSCORE_UEDHOC_KCONFIG)"
config ZEPHYR_UOSCORE_UEDHOC_MODULE
	bool
	default y
endmenu
menu "zcbor (/home/tanneberger/workspace/lf/lf-west-template/deps/modules/lib/zcbor)"
osource "$(ZEPHYR_ZCBOR_KCONFIG)"
config ZEPHYR_ZCBOR_MODULE
	bool
	default y
endmenu
```

## examples/federated/ethernet/buidl/Kconfig/arch/Kconfig
```kconfig
# Load arch Kconfig descriptions.
osource "/home/tanneberger/workspace/lf/lf-west-template/deps/zephyr/arch/x86/Kconfig"
osource "/home/tanneberger/workspace/lf/lf-west-template/deps/zephyr/arch/xtensa/Kconfig"
osource "/home/tanneberger/workspace/lf/lf-west-template/deps/zephyr/arch/sparc/Kconfig"
osource "/home/tanneberger/workspace/lf/lf-west-template/deps/zephyr/arch/riscv/Kconfig"
osource "/home/tanneberger/workspace/lf/lf-west-template/deps/zephyr/arch/posix/Kconfig"
osource "/home/tanneberger/workspace/lf/lf-west-template/deps/zephyr/arch/nios2/Kconfig"
osource "/home/tanneberger/workspace/lf/lf-west-template/deps/zephyr/arch/mips/Kconfig"
osource "/home/tanneberger/workspace/lf/lf-west-template/deps/zephyr/arch/arm64/Kconfig"
osource "/home/tanneberger/workspace/lf/lf-west-template/deps/zephyr/arch/arm/Kconfig"
osource "/home/tanneberger/workspace/lf/lf-west-template/deps/zephyr/arch/arc/Kconfig"
```
