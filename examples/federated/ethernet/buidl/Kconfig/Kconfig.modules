## examples/federated/ethernet/buidl/Kconfig/soc/Kconfig.soc
```kconfig
# Load SoC Kconfig descriptions.
osource "/home/tanneberger/workspace/lf/lf-west-template/deps/zephyr/soc/xlnx/zynqmp/Kconfig.soc"
osource "/home/tanneberger/workspace/lf/lf-west-template/deps/zephyr/soc/xlnx/zynq7000/Kconfig.soc"
osource "/home/tanneberger/workspace/lf/lf-west-template/deps/zephyr/soc/xen/Kconfig.soc"
osource "/home/tanneberger/workspace/lf/lf-west-template/deps/zephyr/soc/ti/simplelink/Kconfig.soc"
osource "/home/tanneberger/workspace/lf/lf-west-template/deps/zephyr/soc/ti/lm3s6965/Kconfig.soc"
osource "/home/tanneberger/workspace/lf/lf-west-template/deps/zephyr/soc/ti/k3/Kconfig.soc"
osource "/home/tanneberger/workspace/lf/lf-west-template/deps/zephyr/soc/telink/tlsr/Kconfig.soc"
osource "/home/tanneberger/workspace/lf/lf-west-template/deps/zephyr/soc/starfive/jh71xx/Kconfig.soc"
osource "/home/tanneberger/workspace/lf/lf-west-template/deps/zephyr/soc/st/stm32/Kconfig.soc"
osource "/home/tanneberger/workspace/lf/lf-west-template/deps/zephyr/soc/snps/qemu_arc/Kconfig.soc"
osource "/home/tanneberger/workspace/lf/lf-west-template/deps/zephyr/soc/snps/nsim/arc_v/Kconfig.soc"
osource "/home/tanneberger/workspace/lf/lf-west-template/deps/zephyr/soc/snps/nsim/arc_classic/Kconfig.soc"
osource "/home/tanneberger/workspace/lf/lf-west-template/deps/zephyr/soc/snps/hsdk4xd/Kconfig.soc"
osource "/home/tanneberger/workspace/lf/lf-west-template/deps/zephyr/soc/snps/hsdk/Kconfig.soc"
osource "/home/tanneberger/workspace/lf/lf-west-template/deps/zephyr/soc/snps/emsk/Kconfig.soc"
osource "/home/tanneberger/workspace/lf/lf-west-template/deps/zephyr/soc/snps/emsdp/Kconfig.soc"
osource "/home/tanneberger/workspace/lf/lf-west-template/deps/zephyr/soc/snps/arc_iot/Kconfig.soc"
osource "/home/tanneberger/workspace/lf/lf-west-template/deps/zephyr/soc/silabs/Kconfig.soc"
osource "/home/tanneberger/workspace/lf/lf-west-template/deps/zephyr/soc/sifive/sifive_freedom/Kconfig.soc"
osource "/home/tanneberger/workspace/lf/lf-west-template/deps/zephyr/soc/rockchip/Kconfig.soc"
osource "/home/tanneberger/workspace/lf/lf-west-template/deps/zephyr/soc/renode/riscv_virtual/Kconfig.soc"
osource "/home/tanneberger/workspace/lf/lf-west-template/deps/zephyr/soc/renesas/smartbond/Kconfig.soc"
osource "/home/tanneberger/workspace/lf/lf-west-template/deps/zephyr/soc/renesas/rzt2m/Kconfig.soc"
osource "/home/tanneberger/workspace/lf/lf-west-template/deps/zephyr/soc/renesas/rcar/Kconfig.soc"
osource "/home/tanneberger/workspace/lf/lf-west-template/deps/zephyr/soc/renesas/ra/Kconfig.soc"
osource "/home/tanneberger/workspace/lf/lf-west-template/deps/zephyr/soc/raspberrypi/Kconfig.soc"
osource "/home/tanneberger/workspace/lf/lf-west-template/deps/zephyr/soc/quicklogic/eos_s3/Kconfig.soc"
osource "/home/tanneberger/workspace/lf/lf-west-template/deps/zephyr/soc/qemu/virt_riscv/Kconfig.soc"
osource "/home/tanneberger/workspace/lf/lf-west-template/deps/zephyr/soc/qemu/malta/Kconfig.soc"
osource "/home/tanneberger/workspace/lf/lf-west-template/deps/zephyr/soc/openisa/rv32m1/Kconfig.soc"
osource "/home/tanneberger/workspace/lf/lf-west-template/deps/zephyr/soc/nxp/s32/Kconfig.soc"
osource "/home/tanneberger/workspace/lf/lf-west-template/deps/zephyr/soc/nxp/rw/Kconfig.soc"
osource "/home/tanneberger/workspace/lf/lf-west-template/deps/zephyr/soc/nxp/mcx/Kconfig.soc"
osource "/home/tanneberger/workspace/lf/lf-west-template/deps/zephyr/soc/nxp/lpc/Kconfig.soc"
osource "/home/tanneberger/workspace/lf/lf-west-template/deps/zephyr/soc/nxp/layerscape/Kconfig.soc"
osource "/home/tanneberger/workspace/lf/lf-west-template/deps/zephyr/soc/nxp/kinetis/Kconfig.soc"
osource "/home/tanneberger/workspace/lf/lf-west-template/deps/zephyr/soc/nxp/imxrt/Kconfig.soc"
osource "/home/tanneberger/workspace/lf/lf-west-template/deps/zephyr/soc/nxp/imx/Kconfig.soc"
osource "/home/tanneberger/workspace/lf/lf-west-template/deps/zephyr/soc/nuvoton/numicro/Kconfig.soc"
osource "/home/tanneberger/workspace/lf/lf-west-template/deps/zephyr/soc/nuvoton/numaker/Kconfig.soc"
osource "/home/tanneberger/workspace/lf/lf-west-template/deps/zephyr/soc/nuvoton/npcx/Kconfig.soc"
osource "/home/tanneberger/workspace/lf/lf-west-template/deps/zephyr/soc/nordic/Kconfig.soc"
osource "/home/tanneberger/workspace/lf/lf-west-template/deps/zephyr/soc/neorv32/Kconfig.soc"
osource "/home/tanneberger/workspace/lf/lf-west-template/deps/zephyr/soc/native/inf_clock/Kconfig.soc"
osource "/home/tanneberger/workspace/lf/lf-west-template/deps/zephyr/soc/microchip/miv/Kconfig.soc"
osource "/home/tanneberger/workspace/lf/lf-west-template/deps/zephyr/soc/microchip/mec/Kconfig.soc"
osource "/home/tanneberger/workspace/lf/lf-west-template/deps/zephyr/soc/mediatek/mtk_adsp/Kconfig.soc"
osource "/home/tanneberger/workspace/lf/lf-west-template/deps/zephyr/soc/lowrisc/opentitan/Kconfig.soc"
osource "/home/tanneberger/workspace/lf/lf-west-template/deps/zephyr/soc/litex/litex_vexriscv/Kconfig.soc"
osource "/home/tanneberger/workspace/lf/lf-west-template/deps/zephyr/soc/ite/ec/Kconfig.soc"
osource "/home/tanneberger/workspace/lf/lf-west-template/deps/zephyr/soc/intel/raptor_lake/Kconfig.soc"
osource "/home/tanneberger/workspace/lf/lf-west-template/deps/zephyr/soc/intel/lakemont/Kconfig.soc"
osource "/home/tanneberger/workspace/lf/lf-west-template/deps/zephyr/soc/intel/intel_socfpga_std/Kconfig.soc"
osource "/home/tanneberger/workspace/lf/lf-west-template/deps/zephyr/soc/intel/intel_socfpga/Kconfig.soc"
osource "/home/tanneberger/workspace/lf/lf-west-template/deps/zephyr/soc/intel/intel_niosv/Kconfig.soc"
osource "/home/tanneberger/workspace/lf/lf-west-template/deps/zephyr/soc/intel/intel_ish/Kconfig.soc"
osource "/home/tanneberger/workspace/lf/lf-west-template/deps/zephyr/soc/intel/intel_adsp/Kconfig.soc"
osource "/home/tanneberger/workspace/lf/lf-west-template/deps/zephyr/soc/intel/elkhart_lake/Kconfig.soc"
osource "/home/tanneberger/workspace/lf/lf-west-template/deps/zephyr/soc/intel/atom/Kconfig.soc"
osource "/home/tanneberger/workspace/lf/lf-west-template/deps/zephyr/soc/intel/apollo_lake/Kconfig.soc"
osource "/home/tanneberger/workspace/lf/lf-west-template/deps/zephyr/soc/intel/alder_lake/Kconfig.soc"
osource "/home/tanneberger/workspace/lf/lf-west-template/deps/zephyr/soc/infineon/cat3/Kconfig.soc"
osource "/home/tanneberger/workspace/lf/lf-west-template/deps/zephyr/soc/infineon/cat1b/Kconfig.soc"
osource "/home/tanneberger/workspace/lf/lf-west-template/deps/zephyr/soc/infineon/cat1a/Kconfig.soc"
osource "/home/tanneberger/workspace/lf/lf-west-template/deps/zephyr/soc/gd/gd32/Kconfig.soc"
osource "/home/tanneberger/workspace/lf/lf-west-template/deps/zephyr/soc/gaisler/leon3/Kconfig.soc"
osource "/home/tanneberger/workspace/lf/lf-west-template/deps/zephyr/soc/gaisler/gr716a/Kconfig.soc"
osource "/home/tanneberger/workspace/lf/lf-west-template/deps/zephyr/soc/espressif/Kconfig.soc"
osource "/home/tanneberger/workspace/lf/lf-west-template/deps/zephyr/soc/ene/kb1200/Kconfig.soc"
osource "/home/tanneberger/workspace/lf/lf-west-template/deps/zephyr/soc/efinix/sapphire/Kconfig.soc"
osource "/home/tanneberger/workspace/lf/lf-west-template/deps/zephyr/soc/cdns/xtensa_sample_controller/Kconfig.soc"
osource "/home/tanneberger/workspace/lf/lf-west-template/deps/zephyr/soc/cdns/dc233c/Kconfig.soc"
osource "/home/tanneberger/workspace/lf/lf-west-template/deps/zephyr/soc/brcm/bcmvk/Kconfig.soc"
osource "/home/tanneberger/workspace/lf/lf-west-template/deps/zephyr/soc/brcm/bcm2712/Kconfig.soc"
osource "/home/tanneberger/workspace/lf/lf-west-template/deps/zephyr/soc/brcm/bcm2711/Kconfig.soc"
osource "/home/tanneberger/workspace/lf/lf-west-template/deps/zephyr/soc/atmel/sam0/Kconfig.soc"
osource "/home/tanneberger/workspace/lf/lf-west-template/deps/zephyr/soc/atmel/sam/Kconfig.soc"
osource "/home/tanneberger/workspace/lf/lf-west-template/deps/zephyr/soc/aspeed/Kconfig.soc"
osource "/home/tanneberger/workspace/lf/lf-west-template/deps/zephyr/soc/arm/Kconfig.soc"
osource "/home/tanneberger/workspace/lf/lf-west-template/deps/zephyr/soc/arm/beetle/Kconfig.soc"
osource "/home/tanneberger/workspace/lf/lf-west-template/deps/zephyr/soc/andestech/Kconfig.soc"
osource "/home/tanneberger/workspace/lf/lf-west-template/deps/zephyr/soc/ambiq/Kconfig.soc"
osource "/home/tanneberger/workspace/lf/lf-west-template/deps/zephyr/soc/altr/zephyr_nios2f/Kconfig.soc"
osource "/home/tanneberger/workspace/lf/lf-west-template/deps/zephyr/soc/altr/qemu_nios2/Kconfig.soc"
osource "/home/tanneberger/workspace/lf/lf-west-template/deps/zephyr/soc/adi/max32/Kconfig.soc"
```

## examples/federated/ethernet/west.yml
```yaml
# Copyright (c) 2023 <erling.r.jellum@ntnu.no>
# Template manifest file for Lingua Franca zephyr projects

manifest:
  self:
    west-commands: scripts/west-commands.yml
    path: .

  remotes:
    - name: zephyrproject-rtos
      url-base: https://github.com/zephyrproject-rtos

  projects:
    - name: zephyr
      remote: zephyrproject-rtos
      revision: v4.1.0
      import:
        path-prefix: deps
```
