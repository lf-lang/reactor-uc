## examples/federated/ethernet/buidl/Kconfig/soc/Kconfig
```kconfig
# Load Zephyr SoC Kconfig descriptions.
osource "/home/tanneberger/workspace/lf/lf-west-template/deps/zephyr/soc/xlnx/zynqmp/Kconfig"
osource "/home/tanneberger/workspace/lf/lf-west-template/deps/zephyr/soc/xlnx/zynq7000/Kconfig"
osource "/home/tanneberger/workspace/lf/lf-west-template/deps/zephyr/soc/xen/Kconfig"
osource "/home/tanneberger/workspace/lf/lf-west-template/deps/zephyr/soc/ti/simplelink/Kconfig"
osource "/home/tanneberger/workspace/lf/lf-west-template/deps/zephyr/soc/ti/lm3s6965/Kconfig"
osource "/home/tanneberger/workspace/lf/lf-west-template/deps/zephyr/soc/ti/k3/Kconfig"
osource "/home/tanneberger/workspace/lf/lf-west-template/deps/zephyr/soc/telink/tlsr/Kconfig"
osource "/home/tanneberger/workspace/lf/lf-west-template/deps/zephyr/soc/starfive/jh71xx/Kconfig"
osource "/home/tanneberger/workspace/lf/lf-west-template/deps/zephyr/soc/st/stm32/Kconfig"
osource "/home/tanneberger/workspace/lf/lf-west-template/deps/zephyr/soc/snps/qemu_arc/Kconfig"
osource "/home/tanneberger/workspace/lf/lf-west-template/deps/zephyr/soc/snps/nsim/arc_v/Kconfig"
osource "/home/tanneberger/workspace/lf/lf-west-template/deps/zephyr/soc/snps/nsim/arc_classic/Kconfig"
osource "/home/tanneberger/workspace/lf/lf-west-template/deps/zephyr/soc/snps/hsdk4xd/Kconfig"
osource "/home/tanneberger/workspace/lf/lf-west-template/deps/zephyr/soc/snps/hsdk/Kconfig"
osource "/home/tanneberger/workspace/lf/lf-west-template/deps/zephyr/soc/snps/emsk/Kconfig"
osource "/home/tanneberger/workspace/lf/lf-west-template/deps/zephyr/soc/snps/emsdp/Kconfig"
osource "/home/tanneberger/workspace/lf/lf-west-template/deps/zephyr/soc/snps/arc_iot/Kconfig"
osource "/home/tanneberger/workspace/lf/lf-west-template/deps/zephyr/soc/silabs/Kconfig"
osource "/home/tanneberger/workspace/lf/lf-west-template/deps/zephyr/soc/sifive/sifive_freedom/Kconfig"
osource "/home/tanneberger/workspace/lf/lf-west-template/deps/zephyr/soc/rockchip/Kconfig"
osource "/home/tanneberger/workspace/lf/lf-west-template/deps/zephyr/soc/renode/riscv_virtual/Kconfig"
osource "/home/tanneberger/workspace/lf/lf-west-template/deps/zephyr/soc/renesas/smartbond/Kconfig"
osource "/home/tanneberger/workspace/lf/lf-west-template/deps/zephyr/soc/renesas/rzt2m/Kconfig"
osource "/home/tanneberger/workspace/lf/lf-west-template/deps/zephyr/soc/renesas/rcar/Kconfig"
osource "/home/tanneberger/workspace/lf/lf-west-template/deps/zephyr/soc/renesas/ra/Kconfig"
osource "/home/tanneberger/workspace/lf/lf-west-template/deps/zephyr/soc/raspberrypi/Kconfig"
osource "/home/tanneberger/workspace/lf/lf-west-template/deps/zephyr/soc/quicklogic/eos_s3/Kconfig"
osource "/home/tanneberger/workspace/lf/lf-west-template/deps/zephyr/soc/qemu/virt_riscv/Kconfig"
osource "/home/tanneberger/workspace/lf/lf-west-template/deps/zephyr/soc/qemu/malta/Kconfig"
osource "/home/tanneberger/workspace/lf/lf-west-template/deps/zephyr/soc/openisa/rv32m1/Kconfig"
osource "/home/tanneberger/workspace/lf/lf-west-template/deps/zephyr/soc/nxp/s32/Kconfig"
osource "/home/tanneberger/workspace/lf/lf-west-template/deps/zephyr/soc/nxp/rw/Kconfig"
osource "/home/tanneberger/workspace/lf/lf-west-template/deps/zephyr/soc/nxp/mcx/Kconfig"
osource "/home/tanneberger/workspace/lf/lf-west-template/deps/zephyr/soc/nxp/lpc/Kconfig"
osource "/home/tanneberger/workspace/lf/lf-west-template/deps/zephyr/soc/nxp/layerscape/Kconfig"
osource "/home/tanneberger/workspace/lf/lf-west-template/deps/zephyr/soc/nxp/kinetis/Kconfig"
osource "/home/tanneberger/workspace/lf/lf-west-template/deps/zephyr/soc/nxp/imxrt/Kconfig"
osource "/home/tanneberger/workspace/lf/lf-west-template/deps/zephyr/soc/nxp/imx/Kconfig"
osource "/home/tanneberger/workspace/lf/lf-west-template/deps/zephyr/soc/nuvoton/numicro/Kconfig"
osource "/home/tanneberger/workspace/lf/lf-west-template/deps/zephyr/soc/nuvoton/numaker/Kconfig"
osource "/home/tanneberger/workspace/lf/lf-west-template/deps/zephyr/soc/nuvoton/npcx/Kconfig"
osource "/home/tanneberger/workspace/lf/lf-west-template/deps/zephyr/soc/nordic/Kconfig"
osource "/home/tanneberger/workspace/lf/lf-west-template/deps/zephyr/soc/neorv32/Kconfig"
osource "/home/tanneberger/workspace/lf/lf-west-template/deps/zephyr/soc/native/inf_clock/Kconfig"
osource "/home/tanneberger/workspace/lf/lf-west-template/deps/zephyr/soc/microchip/miv/Kconfig"
osource "/home/tanneberger/workspace/lf/lf-west-template/deps/zephyr/soc/microchip/mec/Kconfig"
osource "/home/tanneberger/workspace/lf/lf-west-template/deps/zephyr/soc/mediatek/mtk_adsp/Kconfig"
osource "/home/tanneberger/workspace/lf/lf-west-template/deps/zephyr/soc/lowrisc/opentitan/Kconfig"
osource "/home/tanneberger/workspace/lf/lf-west-template/deps/zephyr/soc/litex/litex_vexriscv/Kconfig"
osource "/home/tanneberger/workspace/lf/lf-west-template/deps/zephyr/soc/ite/ec/Kconfig"
osource "/home/tanneberger/workspace/lf/lf-west-template/deps/zephyr/soc/intel/raptor_lake/Kconfig"
osource "/home/tanneberger/workspace/lf/lf-west-template/deps/zephyr/soc/intel/lakemont/Kconfig"
osource "/home/tanneberger/workspace/lf/lf-west-template/deps/zephyr/soc/intel/intel_socfpga_std/Kconfig"
osource "/home/tanneberger/workspace/lf/lf-west-template/deps/zephyr/soc/intel/intel_socfpga/Kconfig"
osource "/home/tanneberger/workspace/lf/lf-west-template/deps/zephyr/soc/intel/intel_niosv/Kconfig"
osource "/home/tanneberger/workspace/lf/lf-west-template/deps/zephyr/soc/intel/intel_ish/Kconfig"
osource "/home/tanneberger/workspace/lf/lf-west-template/deps/zephyr/soc/intel/intel_adsp/Kconfig"
osource "/home/tanneberger/workspace/lf/lf-west-template/deps/zephyr/soc/intel/elkhart_lake/Kconfig"
osource "/home/tanneberger/workspace/lf/lf-west-template/deps/zephyr/soc/intel/atom/Kconfig"
osource "/home/tanneberger/workspace/lf/lf-west-template/deps/zephyr/soc/intel/apollo_lake/Kconfig"
osource "/home/tanneberger/workspace/lf/lf-west-template/deps/zephyr/soc/intel/alder_lake/Kconfig"
osource "/home/tanneberger/workspace/lf/lf-west-template/deps/zephyr/soc/infineon/cat3/Kconfig"
osource "/home/tanneberger/workspace/lf/lf-west-template/deps/zephyr/soc/infineon/cat1b/Kconfig"
osource "/home/tanneberger/workspace/lf/lf-west-template/deps/zephyr/soc/infineon/cat1a/Kconfig"
osource "/home/tanneberger/workspace/lf/lf-west-template/deps/zephyr/soc/gd/gd32/Kconfig"
osource "/home/tanneberger/workspace/lf/lf-west-template/deps/zephyr/soc/gaisler/leon3/Kconfig"
osource "/home/tanneberger/workspace/lf/lf-west-template/deps/zephyr/soc/gaisler/gr716a/Kconfig"
osource "/home/tanneberger/workspace/lf/lf-west-template/deps/zephyr/soc/espressif/Kconfig"
osource "/home/tanneberger/workspace/lf/lf-west-template/deps/zephyr/soc/ene/kb1200/Kconfig"
osource "/home/tanneberger/workspace/lf/lf-west-template/deps/zephyr/soc/efinix/sapphire/Kconfig"
osource "/home/tanneberger/workspace/lf/lf-west-template/deps/zephyr/soc/cdns/xtensa_sample_controller/Kconfig"
osource "/home/tanneberger/workspace/lf/lf-west-template/deps/zephyr/soc/cdns/dc233c/Kconfig"
osource "/home/tanneberger/workspace/lf/lf-west-template/deps/zephyr/soc/brcm/bcmvk/Kconfig"
osource "/home/tanneberger/workspace/lf/lf-west-template/deps/zephyr/soc/brcm/bcm2712/Kconfig"
osource "/home/tanneberger/workspace/lf/lf-west-template/deps/zephyr/soc/brcm/bcm2711/Kconfig"
osource "/home/tanneberger/workspace/lf/lf-west-template/deps/zephyr/soc/atmel/sam0/Kconfig"
osource "/home/tanneberger/workspace/lf/lf-west-template/deps/zephyr/soc/atmel/sam/Kconfig"
osource "/home/tanneberger/workspace/lf/lf-west-template/deps/zephyr/soc/aspeed/Kconfig"
osource "/home/tanneberger/workspace/lf/lf-west-template/deps/zephyr/soc/arm/Kconfig"
osource "/home/tanneberger/workspace/lf/lf-west-template/deps/zephyr/soc/arm/beetle/Kconfig"
osource "/home/tanneberger/workspace/lf/lf-west-template/deps/zephyr/soc/andestech/Kconfig"
osource "/home/tanneberger/workspace/lf/lf-west-template/deps/zephyr/soc/ambiq/Kconfig"
osource "/home/tanneberger/workspace/lf/lf-west-template/deps/zephyr/soc/altr/zephyr_nios2f/Kconfig"
osource "/home/tanneberger/workspace/lf/lf-west-template/deps/zephyr/soc/altr/qemu_nios2/Kconfig"
osource "/home/tanneberger/workspace/lf/lf-west-template/deps/zephyr/soc/adi/max32/Kconfig"
```
