## examples/federated/ethernet/buidl/Kconfig/soc/Kconfig.defconfig
```kconfig
# Load Zephyr SoC Kconfig defconfig.
osource "/home/tanneberger/workspace/lf/lf-west-template/deps/zephyr/soc/xlnx/zynqmp/Kconfig.defconfig"
osource "/home/tanneberger/workspace/lf/lf-west-template/deps/zephyr/soc/xlnx/zynq7000/Kconfig.defconfig"
osource "/home/tanneberger/workspace/lf/lf-west-template/deps/zephyr/soc/xen/Kconfig.defconfig"
osource "/home/tanneberger/workspace/lf/lf-west-template/deps/zephyr/soc/ti/simplelink/Kconfig.defconfig"
osource "/home/tanneberger/workspace/lf/lf-west-template/deps/zephyr/soc/ti/lm3s6965/Kconfig.defconfig"
osource "/home/tanneberger/workspace/lf/lf-west-template/deps/zephyr/soc/ti/k3/Kconfig.defconfig"
osource "/home/tanneberger/workspace/lf/lf-west-template/deps/zephyr/soc/telink/tlsr/Kconfig.defconfig"
osource "/home/tanneberger/workspace/lf/lf-west-template/deps/zephyr/soc/starfive/jh71xx/Kconfig.defconfig"
osource "/home/tanneberger/workspace/lf/lf-west-template/deps/zephyr/soc/st/stm32/Kconfig.defconfig"
osource "/home/tanneberger/workspace/lf/lf-west-template/deps/zephyr/soc/snps/qemu_arc/Kconfig.defconfig"
osource "/home/tanneberger/workspace/lf/lf-west-template/deps/zephyr/soc/snps/nsim/arc_v/Kconfig.defconfig"
osource "/home/tanneberger/workspace/lf/lf-west-template/deps/zephyr/soc/snps/nsim/arc_classic/Kconfig.defconfig"
osource "/home/tanneberger/workspace/lf/lf-west-template/deps/zephyr/soc/snps/hsdk4xd/Kconfig.defconfig"
osource "/home/tanneberger/workspace/lf/lf-west-template/deps/zephyr/soc/snps/hsdk/Kconfig.defconfig"
osource "/home/tanneberger/workspace/lf/lf-west-template/deps/zephyr/soc/snps/emsk/Kconfig.defconfig"
osource "/home/tanneberger/workspace/lf/lf-west-template/deps/zephyr/soc/snps/emsdp/Kconfig.defconfig"
osource "/home/tanneberger/workspace/lf/lf-west-template/deps/zephyr/soc/snps/arc_iot/Kconfig.defconfig"
osource "/home/tanneberger/workspace/lf/lf-west-template/deps/zephyr/soc/silabs/Kconfig.defconfig"
osource "/home/tanneberger/workspace/lf/lf-west-template/deps/zephyr/soc/sifive/sifive_freedom/Kconfig.defconfig"
osource "/home/tanneberger/workspace/lf/lf-west-template/deps/zephyr/soc/rockchip/Kconfig.defconfig"
osource "/home/tanneberger/workspace/lf/lf-west-template/deps/zephyr/soc/renode/riscv_virtual/Kconfig.defconfig"
osource "/home/tanneberger/workspace/lf/lf-west-template/deps/zephyr/soc/renesas/smartbond/Kconfig.defconfig"
osource "/home/tanneberger/workspace/lf/lf-west-template/deps/zephyr/soc/renesas/rzt2m/Kconfig.defconfig"
osource "/home/tanneberger/workspace/lf/lf-west-template/deps/zephyr/soc/renesas/rcar/Kconfig.defconfig"
osource "/home/tanneberger/workspace/lf/lf-west-template/deps/zephyr/soc/renesas/ra/Kconfig.defconfig"
osource "/home/tanneberger/workspace/lf/lf-west-template/deps/zephyr/soc/raspberrypi/Kconfig.defconfig"
osource "/home/tanneberger/workspace/lf/lf-west-template/deps/zephyr/soc/quicklogic/eos_s3/Kconfig.defconfig"
osource "/home/tanneberger/workspace/lf/lf-west-template/deps/zephyr/soc/qemu/virt_riscv/Kconfig.defconfig"
osource "/home/tanneberger/workspace/lf/lf-west-template/deps/zephyr/soc/qemu/malta/Kconfig.defconfig"
osource "/home/tanneberger/workspace/lf/lf-west-template/deps/zephyr/soc/openisa/rv32m1/Kconfig.defconfig"
osource "/home/tanneberger/workspace/lf/lf-west-template/deps/zephyr/soc/nxp/s32/Kconfig.defconfig"
osource "/home/tanneberger/workspace/lf/lf-west-template/deps/zephyr/soc/nxp/rw/Kconfig.defconfig"
osource "/home/tanneberger/workspace/lf/lf-west-template/deps/zephyr/soc/nxp/mcx/Kconfig.defconfig"
osource "/home/tanneberger/workspace/lf/lf-west-template/deps/zephyr/soc/nxp/lpc/Kconfig.defconfig"
osource "/home/tanneberger/workspace/lf/lf-west-template/deps/zephyr/soc/nxp/layerscape/Kconfig.defconfig"
osource "/home/tanneberger/workspace/lf/lf-west-template/deps/zephyr/soc/nxp/kinetis/Kconfig.defconfig"
osource "/home/tanneberger/workspace/lf/lf-west-template/deps/zephyr/soc/nxp/imxrt/Kconfig.defconfig"
osource "/home/tanneberger/workspace/lf/lf-west-template/deps/zephyr/soc/nxp/imx/Kconfig.defconfig"
osource "/home/tanneberger/workspace/lf/lf-west-template/deps/zephyr/soc/nuvoton/numicro/Kconfig.defconfig"
osource "/home/tanneberger/workspace/lf/lf-west-template/deps/zephyr/soc/nuvoton/numaker/Kconfig.defconfig"
osource "/home/tanneberger/workspace/lf/lf-west-template/deps/zephyr/soc/nuvoton/npcx/Kconfig.defconfig"
osource "/home/tanneberger/workspace/lf/lf-west-template/deps/zephyr/soc/nordic/Kconfig.defconfig"
osource "/home/tanneberger/workspace/lf/lf-west-template/deps/zephyr/soc/neorv32/Kconfig.defconfig"
osource "/home/tanneberger/workspace/lf/lf-west-template/deps/zephyr/soc/native/inf_clock/Kconfig.defconfig"
osource "/home/tanneberger/workspace/lf/lf-west-template/deps/zephyr/soc/microchip/miv/Kconfig.defconfig"
osource "/home/tanneberger/workspace/lf/lf-west-template/deps/zephyr/soc/microchip/mec/Kconfig.defconfig"
osource "/home/tanneberger/workspace/lf/lf-west-template/deps/zephyr/soc/mediatek/mtk_adsp/Kconfig.defconfig"
osource "/home/tanneberger/workspace/lf/lf-west-template/deps/zephyr/soc/lowrisc/opentitan/Kconfig.defconfig"
osource "/home/tanneberger/workspace/lf/lf-west-template/deps/zephyr/soc/litex/litex_vexriscv/Kconfig.defconfig"
osource "/home/tanneberger/workspace/lf/lf-west-template/deps/zephyr/soc/ite/ec/Kconfig.defconfig"
osource "/home/tanneberger/workspace/lf/lf-west-template/deps/zephyr/soc/intel/raptor_lake/Kconfig.defconfig"
osource "/home/tanneberger/workspace/lf/lf-west-template/deps/zephyr/soc/intel/lakemont/Kconfig.defconfig"
osource "/home/tanneberger/workspace/lf/lf-west-template/deps/zephyr/soc/intel/intel_socfpga_std/Kconfig.defconfig"
osource "/home/tanneberger/workspace/lf/lf-west-template/deps/zephyr/soc/intel/intel_socfpga/Kconfig.defconfig"
osource "/home/tanneberger/workspace/lf/lf-west-template/deps/zephyr/soc/intel/intel_niosv/Kconfig.defconfig"
osource "/home/tanneberger/workspace/lf/lf-west-template/deps/zephyr/soc/intel/intel_ish/Kconfig.defconfig"
osource "/home/tanneberger/workspace/lf/lf-west-template/deps/zephyr/soc/intel/intel_adsp/Kconfig.defconfig"
osource "/home/tanneberger/workspace/lf/lf-west-template/deps/zephyr/soc/intel/elkhart_lake/Kconfig.defconfig"
osource "/home/tanneberger/workspace/lf/lf-west-template/deps/zephyr/soc/intel/atom/Kconfig.defconfig"
osource "/home/tanneberger/workspace/lf/lf-west-template/deps/zephyr/soc/intel/apollo_lake/Kconfig.defconfig"
osource "/home/tanneberger/workspace/lf/lf-west-template/deps/zephyr/soc/intel/alder_lake/Kconfig.defconfig"
osource "/home/tanneberger/workspace/lf/lf-west-template/deps/zephyr/soc/infineon/cat3/Kconfig.defconfig"
osource "/home/tanneberger/workspace/lf/lf-west-template/deps/zephyr/soc/infineon/cat1b/Kconfig.defconfig"
osource "/home/tanneberger/workspace/lf/lf-west-template/deps/zephyr/soc/infineon/cat1a/Kconfig.defconfig"
osource "/home/tanneberger/workspace/lf/lf-west-template/deps/zephyr/soc/gd/gd32/Kconfig.defconfig"
osource "/home/tanneberger/workspace/lf/lf-west-template/deps/zephyr/soc/gaisler/leon3/Kconfig.defconfig"
osource "/home/tanneberger/workspace/lf/lf-west-template/deps/zephyr/soc/gaisler/gr716a/Kconfig.defconfig"
osource "/home/tanneberger/workspace/lf/lf-west-template/deps/zephyr/soc/espressif/Kconfig.defconfig"
osource "/home/tanneberger/workspace/lf/lf-west-template/deps/zephyr/soc/ene/kb1200/Kconfig.defconfig"
osource "/home/tanneberger/workspace/lf/lf-west-template/deps/zephyr/soc/efinix/sapphire/Kconfig.defconfig"
osource "/home/tanneberger/workspace/lf/lf-west-template/deps/zephyr/soc/cdns/xtensa_sample_controller/Kconfig.defconfig"
osource "/home/tanneberger/workspace/lf/lf-west-template/deps/zephyr/soc/cdns/dc233c/Kconfig.defconfig"
osource "/home/tanneberger/workspace/lf/lf-west-template/deps/zephyr/soc/brcm/bcmvk/Kconfig.defconfig"
osource "/home/tanneberger/workspace/lf/lf-west-template/deps/zephyr/soc/brcm/bcm2712/Kconfig.defconfig"
osource "/home/tanneberger/workspace/lf/lf-west-template/deps/zephyr/soc/brcm/bcm2711/Kconfig.defconfig"
osource "/home/tanneberger/workspace/lf/lf-west-template/deps/zephyr/soc/atmel/sam0/Kconfig.defconfig"
osource "/home/tanneberger/workspace/lf/lf-west-template/deps/zephyr/soc/atmel/sam/Kconfig.defconfig"
osource "/home/tanneberger/workspace/lf/lf-west-template/deps/zephyr/soc/aspeed/Kconfig.defconfig"
osource "/home/tanneberger/workspace/lf/lf-west-template/deps/zephyr/soc/arm/Kconfig.defconfig"
osource "/home/tanneberger/workspace/lf/lf-west-template/deps/zephyr/soc/arm/beetle/Kconfig.defconfig"
osource "/home/tanneberger/workspace/lf/lf-west-template/deps/zephyr/soc/andestech/Kconfig.defconfig"
osource "/home/tanneberger/workspace/lf/lf-west-template/deps/zephyr/soc/ambiq/Kconfig.defconfig"
osource "/home/tanneberger/workspace/lf/lf-west-template/deps/zephyr/soc/altr/zephyr_nios2f/Kconfig.defconfig"
osource "/home/tanneberger/workspace/lf/lf-west-template/deps/zephyr/soc/altr/qemu_nios2/Kconfig.defconfig"
osource "/home/tanneberger/workspace/lf/lf-west-template/deps/zephyr/soc/adi/max32/Kconfig.defconfig"
```
