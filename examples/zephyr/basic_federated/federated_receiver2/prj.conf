## CMakeLists.txt
```
cmake_minimum_required(VERSION 3.20.0)
set(BOARD frdm_k64f)
find_package(Zephyr REQUIRED HINTS $ENV{ZEPHYR_BASE})
project(reactor-uc-zephyr)

set(NETWORK_CHANNEL_TCP_POSIX ON CACHE BOOL "")
set(FEDERATED ON CACHE BOOL "")
set(PLATFORM "ZEPHYR" CACHE STRING "Platform to target")
add_subdirectory(../../../../ reactor-uc)

target_sources(app PRIVATE src/receiver.c)
target_link_libraries(app PRIVATE reactor-uc)
```

## prj.conf
```kconfig
CONFIG_NEWLIB_LIBC=y
CONFIG_NETWORKING=y
CONFIG_NET_TCP=y
CONFIG_NET_IPV4=y
CONFIG_NET_SOCKETS=y
CONFIG_POSIX_API=y
CONFIG_ASSERT=y
CONFIG_STACK_CANARIES=y
CONFIG_MAIN_STACK_SIZE=4096
# Network address config

CONFIG_NET_CONFIG_SETTINGS=y
CONFIG_NET_CONFIG_NEED_IPV4=y
CONFIG_NET_CONFIG_MY_IPV4_ADDR="192.168.1.102"

# Support 64-bit time values in vprintk/cbprintf logging.
CONFIG_CBPRINTF_COMPLETE=y
CONFIG_CBPRINTF_FULL_INTEGRAL=y
```

## src/receiver.c
```c
#define PORT_NUM 8902
#define IP_ADDR "192.168.1.100"

#include "../../common/receiver.h"

int main() {
  setup_led();
  lf_start();
}
```
