## CMakeLists.txt
```
cmake_minimum_required(VERSION 3.20.0)

set(BOARD frdm_k64f)
find_package(Zephyr REQUIRED HINTS $ENV{ZEPHYR_BASE})
project(reactor-uc-zephyr)

set(NETWORK_CHANNEL_TCP_POSIX ON CACHE BOOL "blah")
set(PLATFORM "ZEPHYR" CACHE STRING "Platform to target")
add_subdirectory(../../../../ reactor-uc)

target_sources(app PRIVATE src/sender.c)
target_link_libraries(app PRIVATE reactor-uc)
```

## prj.conf
```kconfig
CONFIG_NEWLIB_LIBC=y
CONFIG_NETWORKING=y
CONFIG_NET_TCP=y
CONFIG_NET_IPV4=y
CONFIG_NET_SOCKETS=y
CONFIG_POSIX_API=y
CONFIG_ASSERT=y
CONFIG_STACK_CANARIES=y
CONFIG_MAIN_STACK_SIZE=4096
# Network address config
CONFIG_NET_CONFIG_SETTINGS=y
CONFIG_NET_CONFIG_NEED_IPV4=y
CONFIG_NET_CONFIG_MY_IPV4_ADDR="192.168.1.100"

# Support 64-bit time values in vprintk/cbprintf logging.
CONFIG_CBPRINTF_COMPLETE=y
CONFIG_CBPRINTF_FULL_INTEGRAL=y
```

## src/sender.c
```c
#include "reactor-uc/platform/posix/tcp_ip_channel.h"
#include "reactor-uc/reactor-uc.h"
#include "reactor-uc/serialization.h"
#include "reactor-uc/schedulers/dynamic/scheduler.h"
#include <zephyr/net/net_ip.h>

#include <zephyr/drivers/gpio.h>
#include <zephyr/kernel.h>
#define PORT_CONN_1 8901
#define PORT_CONN_2 8902
#define LED0_NODE DT_ALIAS(led0)
#define SW0_NODE DT_ALIAS(sw0)
#if !DT_NODE_HAS_STATUS(SW0_NODE, okay)
#error "Unsupported board: sw0 devicetree alias is not defined"
#endif

static const struct gpio_dt_spec button = GPIO_DT_SPEC_GET_OR(SW0_NODE, gpios, {0});
static struct gpio_callback button_cb_data;
static const struct gpio_dt_spec led = GPIO_DT_SPEC_GET(LED0_NODE, gpios);

typedef struct {
  char msg[32];
} msg_t;

LF_DEFINE_ACTION_STRUCT(Sender, act, PhysicalAction, 1, 0, 0, 10, bool);
LF_DEFINE_ACTION_CTOR(Sender, act, PhysicalAction, ACTION_POLICY_DEFER, 1, 0, 0, 10, bool);
LF_DEFINE_REACTION_STRUCT(Sender, r, 1);
LF_DEFINE_REACTION_CTOR(Sender, r, 0, NULL, NULL);

LF_DEFINE_OUTPUT_STRUCT(Sender, out, 1, msg_t)
LF_DEFINE_OUTPUT_CTOR(Sender, out, 1)

Sender_act *action_ptr = NULL;

void button_pressed(const struct device *dev, struct gpio_callback *cb, uint32_t pins) {
  printk("Button pressed!\n");
  lf_schedule(action_ptr, 0, true);
}

void setup_button() {
  int ret;

  if (!gpio_is_ready_dt(&button)) {
    printk("Error: button device %s is not ready\n", button.port->name);
    validate(false);
  }

  ret = gpio_pin_configure_dt(&button, GPIO_INPUT);
  if (ret != 0) {
    printk("Error %d: failed to configure %s pin %d\n", ret, button.port->name, button.pin);
    validate(false);
  }

  ret = gpio_pin_interrupt_configure_dt(&button, GPIO_INT_EDGE_TO_ACTIVE);
  if (ret != 0) {
    printk("Error %d: failed to configure interrupt on %s pin %d\n", ret, button.port->name, button.pin);
    validate(false);
  }

  gpio_init_callback(&button_cb_data, button_pressed, BIT(button.pin));
  gpio_add_callback(button.port, &button_cb_data);
  printk("Button is set up!\n");
}

void setup_led() {
  validate(device_is_ready(led.port));
  gpio_pin_configure_dt(&led, GPIO_OUTPUT_ACTIVE);
}

typedef struct {
  Reactor super;
  LF_REACTION_INSTANCE(Sender, r);
  LF_ACTION_INSTANCE(Sender, act);
  LF_PORT_INSTANCE(Sender, out, 1);
  LF_REACTOR_BOOKKEEPING_INSTANCES(1, 2, 0);
} Sender;

LF_DEFINE_REACTION_BODY(Sender, r) {
  LF_SCOPE_SELF(Sender);
  LF_SCOPE_ENV();
  LF_SCOPE_PORT(Sender, out);
  gpio_pin_toggle_dt(&led);
  printf("Reaction triggered @ " PRINTF_TIME " (" PRINTF_TIME "), " PRINTF_TIME ")\n", env->get_elapsed_logical_time(env),
         env->get_logical_time(env), env->get_physical_time(env));
  msg_t val;
  strcpy(val.msg, "Hello From Sender");
  lf_set(out, val);
}

LF_REACTOR_CTOR_SIGNATURE_WITH_PARAMETERS(Sender, OutputExternalCtorArgs *out_external) {
  LF_REACTOR_CTOR_PREAMBLE();
  LF_REACTOR_CTOR(Sender);
  LF_INITIALIZE_REACTION(Sender, r, NEVER);
  LF_INITIALIZE_ACTION(Sender, act, MSEC(0), MSEC(0));
  LF_INITIALIZE_OUTPUT(Sender, out, 1, out_external);

  LF_ACTION_REGISTER_EFFECT(self->act, self->r);
  LF_PORT_REGISTER_SOURCE(self->out, self->r, 1);
}

LF_DEFINE_FEDERATED_OUTPUT_CONNECTION_STRUCT(Sender, out, msg_t)
LF_DEFINE_FEDERATED_OUTPUT_CONNECTION_CTOR(Sender, out, msg_t, 0)

typedef struct {
  FederatedConnectionBundle super;
  TcpIpChannel channel;
  LF_FEDERATED_OUTPUT_CONNECTION_INSTANCE(Sender, out);
  LF_FEDERATED_CONNECTION_BUNDLE_BOOKKEEPING_INSTANCES(0, 1);
} LF_FEDERATED_CONNECTION_BUNDLE_TYPE(Sender, Receiver1);

typedef struct {
  FederatedConnectionBundle super;
  TcpIpChannel channel;
  LF_FEDERATED_OUTPUT_CONNECTION_INSTANCE(Sender, out);
  LF_FEDERATED_CONNECTION_BUNDLE_BOOKKEEPING_INSTANCES(0, 1);
} LF_FEDERATED_CONNECTION_BUNDLE_TYPE(Sender, Receiver2);

LF_FEDERATED_CONNECTION_BUNDLE_CTOR_SIGNATURE(Sender, Receiver1) {
  LF_FEDERATED_CONNECTION_BUNDLE_CTOR_PREAMBLE();
  TcpIpChannel_ctor(&self->channel, "192.168.1.100", PORT_CONN_1, AF_INET, true);

  LF_FEDERATED_CONNECTION_BUNDLE_CALL_CTOR();
  
  LF_INITIALIZE_FEDERATED_OUTPUT_CONNECTION(Sender, out, serialize_payload_default);
}

LF_FEDERATED_CONNECTION_BUNDLE_CTOR_SIGNATURE(Sender, Receiver2) {
  LF_FEDERATED_CONNECTION_BUNDLE_CTOR_PREAMBLE();
  TcpIpChannel_ctor(&self->channel, "192.168.1.100", PORT_CONN_2, AF_INET, true);

  LF_FEDERATED_CONNECTION_BUNDLE_CALL_CTOR();
  
  LF_INITIALIZE_FEDERATED_OUTPUT_CONNECTION(Sender, out, serialize_payload_default);
}

LF_DEFINE_STARTUP_COORDINATOR_STRUCT(Federate, 2, 11);
LF_DEFINE_STARTUP_COORDINATOR_CTOR(Federate, 2, 1, 11, 5, JOIN_IMMEDIATELY);

LF_DEFINE_SHUTDOWN_COORDINATOR_STRUCT(Federate, 9);
LF_DEFINE_SHUTDOWN_COORDINATOR_CTOR(Federate, 1, 9);

LF_DEFINE_CLOCK_SYNC_STRUCT(Federate, 2, 3);
LF_DEFINE_CLOCK_SYNC_DEFAULTS_CTOR(Federate, 2, 3, true);

// Reactor main
typedef struct {
  Reactor super;
  LF_CHILD_REACTOR_INSTANCE(Sender, sender, 1);
  LF_FEDERATED_CONNECTION_BUNDLE_INSTANCE(Sender, Receiver1);
  LF_FEDERATED_CONNECTION_BUNDLE_INSTANCE(Sender, Receiver2);
  LF_CHILD_OUTPUT_CONNECTIONS(sender, out, 1, 1, 2);
  LF_CHILD_OUTPUT_EFFECTS(sender, out, 1, 1, 0);
  LF_CHILD_OUTPUT_OBSERVERS(sender, out,1, 1, 0);
  LF_FEDERATE_BOOKKEEPING_INSTANCES(2);
  LF_DEFINE_STARTUP_COORDINATOR(Federate);
  LF_DEFINE_SHUTDOWN_COORDINATOR(Federate);
  LF_DEFINE_CLOCK_SYNC(Federate);
} MainSender;

LF_REACTOR_CTOR_SIGNATURE(MainSender) {
  LF_FEDERATE_CTOR_PREAMBLE();
  LF_REACTOR_CTOR(MainSender);

  LF_DEFINE_CHILD_OUTPUT_ARGS(sender, out, 1, 1);
  LF_INITIALIZE_CHILD_REACTOR_WITH_PARAMETERS(Sender, sender, 1, _sender_out_args[i]);
  LF_INITIALIZE_FEDERATED_CONNECTION_BUNDLE(Sender, Receiver1);
  LF_INITIALIZE_FEDERATED_CONNECTION_BUNDLE(Sender, Receiver2);
  LF_INITIALIZE_STARTUP_COORDINATOR(Federate);
  LF_INITIALIZE_SHUTDOWN_COORDINATOR(Federate);
  LF_INITIALIZE_CLOCK_SYNC(Federate);

  lf_connect_federated_output((Connection*)self->Sender_Receiver1_bundle.outputs[0], (Port*)self->sender->out);
  lf_connect_federated_output((Connection*)self->Sender_Receiver2_bundle.outputs[0], (Port*)self->sender->out);
}

LF_ENTRY_POINT_FEDERATED(MainSender,32,32,32, FOREVER, true, 2, true)

int main() {
  setup_button();
  setup_led();
  action_ptr = &main_reactor.sender->act;
  lf_start();
}
```
