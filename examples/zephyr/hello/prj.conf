## CMakeLists.txt
```
cmake_minimum_required(VERSION 3.20.0)
find_package(Zephyr REQUIRED HINTS $ENV{ZEPHYR_BASE})
project(reactor-uc-zephyr)
set(PLATFORM "ZEPHYR" CACHE STRING "Platform to target")
add_subdirectory(../../../ reactor-uc)

target_sources(app PRIVATE src/hello.c)
target_compile_definitions(app PRIVATE "SCHEDULER_${SCHEDULER}")
target_link_libraries(app PRIVATE reactor-uc)
```

## prj.conf
```kconfig
# Support 64-bit time values in vprintk/cbprintf logging.
CONFIG_CBPRINTF_COMPLETE=y
CONFIG_CBPRINTF_FULL_INTEGRAL=y
```

## src/hello.c
```c
#include "reactor-uc/reactor-uc.h"
#include "../../../common/timer_source.h" 

LF_DEFINE_REACTION_BODY(TimerSource, r) {
  LF_SCOPE_SELF(TimerSource);
  LF_SCOPE_ENV();
  printf("TimerSource World @ %lld\n", env->get_elapsed_logical_time(env));
}

LF_DEFINE_REACTION_BODY(TimerSource, s) {
  LF_SCOPE_SELF(TimerSource);
  LF_SCOPE_ENV();
  LF_SCOPE_STARTUP(TimerSource);
  
  printf("TimerSource Startup @ %lld\n", env->get_elapsed_logical_time(env));
}

int main() {
  lf_start();
  exit(0);
}
```
